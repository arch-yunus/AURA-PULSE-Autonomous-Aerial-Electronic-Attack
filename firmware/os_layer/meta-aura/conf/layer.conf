## firmware/os_layer/meta-aura/conf/layer.conf
```bitbake
# We have a conf and classes directory, add to BBPATH
BBPATH .= ":${LAYERDIR}"

# We have recipes-* directories, add to BBFILES
BBFILES += "${LAYERDIR}/recipes-*/*/*.bb \
            ${LAYERDIR}/recipes-*/*/*.bbappend"

BBFILE_COLLECTIONS += "meta-aura"
BBFILE_PATTERN_meta-aura = "^${LAYERDIR}/"
BBFILE_PRIORITY_meta-aura = "10"

LAYERDEPENDS_meta-aura = "core"
LAYERSERIES_COMPAT_meta-aura = "honister kirkstone"
```
